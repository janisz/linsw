## Lab_2/package/worms/Config.in
```kconfig
config BR2_PACKAGE_WORMS
	bool "worms"
	depends on BR2_PACKAGE_NCURSES
	help
	  Game worms using ncurses

	  http://www.paulgriffiths.net/program/c/curworm.php
```

## Lab_4/raspberrypi_defconfig
```kconfig
BR2_arm=y
BR2_arm1176jzf_s=y
BR2_TOOLCHAIN_EXTERNAL=y
BR2_TARGET_GENERIC_HOSTNAME="tomasz.janiszewski"
BR2_TARGET_GENERIC_ISSUE="LINSW"
BR2_TARGET_GENERIC_ROOT_PASSWD="root"
BR2_TARGET_GENERIC_GETTY_PORT="ttyAMA0"
BR2_SYSTEM_DHCP="eth0"
BR2_TARGET_TZ_INFO=y
BR2_ROOTFS_OVERLAY="overlays"
BR2_LINUX_KERNEL=y
BR2_LINUX_KERNEL_CUSTOM_TARBALL=y
BR2_LINUX_KERNEL_CUSTOM_TARBALL_LOCATION="http://alpha.mini.pw.edu.pl/~zabolotnyw/linux-c256eb9968c8997dce47350d2075e42f1b3991d3.tar.gz"
BR2_LINUX_KERNEL_DEFCONFIG="bcmrpi_quick"
BR2_LINUX_KERNEL_ZIMAGE=y
BR2_LINUX_KERNEL_INSTALL_TARGET=y
BR2_PACKAGE_RPI_FIRMWARE=y
BR2_PACKAGE_PYTHON=y
BR2_PACKAGE_SUPERVISOR=y
BR2_TARGET_ROOTFS_CPIO=y
BR2_TARGET_ROOTFS_EXT2=y
BR2_TARGET_BAREBOX=y
BR2_TARGET_BAREBOX_CUSTOM_VERSION=y
BR2_TARGET_BAREBOX_CUSTOM_VERSION_VALUE="2015.04.0"
BR2_TARGET_BAREBOX_BOARD_DEFCONFIG="rpi"
```
